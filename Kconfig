## Kconfig
```kconfig
config EXAMPLES_UAC2_DAC
	tristate "USB Audio Class 2.0 (192kHz/24bit) DAC"
	default n
	depends on USBDEV
	---help---
		Enable the USB Audio Class 2.0 (UAC2) 192kHz/24bit High-Resolution DAC application.

if EXAMPLES_UAC2_DAC

config EXAMPLES_UAC2_DAC_PROGNAME
	string "Program name"
	default "uac2_dac"
	---help---
		This is the name of the program that will be used in the NSH shell.

config EXAMPLES_UAC2_DAC_PRIORITY
	int "Task priority"
	default 100

config EXAMPLES_UAC2_DAC_STACKSIZE
	int "Stack size"
	default 4096

config EXAMPLES_UAC2_DAC_MON_PRIORITY
	int "Telemetry monitor thread priority (lower = less audio interference)"
	default 50

config EXAMPLES_UAC2_DAC_MON_CPU
	int "Telemetry monitor CPU (sub-core, SMP builds only)"
	default 1

config EXAMPLES_UAC2_DAC_PUMP_CPU
	int "Audio pump thread CPU (SMP builds only, 0 = main core)"
	default 0

config EXAMPLES_UAC2_DAC_ASMP
	bool "ASMP sub-core telemetry formatter (SubCore 1 worker)"
	default n
	select ASMP
	select FS_ROMFS
	---help---
		Boot SubCore 1 with the monw formatter worker (worker/monw,
		embedded via ROMFS). Telemetry printf formatting moves off the
		main core; the MON thread only UART-dumps worker text.
		Falls back to local formatting if the worker fails to boot.
		Audio is unaffected either way.

endif
```
